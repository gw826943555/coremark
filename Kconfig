## Kconfig
```kconfig
# Kconfig file for package coremark
menuconfig PKG_USING_COREMARK
    bool "a coremark package for rt-thread"
    default n

if PKG_USING_COREMARK

    config PKG_COREMARK_PATH
        string
        default "/packages/misc/coremark"

    choice
        prompt "Version"
        default PKG_USING_COREMARK_LATEST_VERSION
        help
            Select the package version

        config PKG_USING_COREMARK_V100
            bool "v1.0.0"

        config PKG_USING_COREMARK_LATEST_VERSION
            bool "latest"
    endchoice
          
    config PKG_COREMARK_VER
       string
       default "v1.0.0"    if PKG_USING_COREMARK_V100
       default "latest"    if PKG_USING_COREMARK_LATEST_VERSION

endif
```
